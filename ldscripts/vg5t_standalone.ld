OUTPUT_ARCH("riscv")
ENTRY(_start)

MEMORY
{
    ROM (rx)  : ORIGIN = 0x00000000, LENGTH = 512K
    RAM (rwx) : ORIGIN = 0x20000000, LENGTH = 16K
}

REGION_ALIAS("REGION_TEXT", ROM)
REGION_ALIAS("REGION_RODATA", ROM)
REGION_ALIAS("REGION_DATA", RAM)
REGION_ALIAS("REGION_BSS", RAM)
REGION_ALIAS("REGION_STACK", RAM)

STACK_SIZE = 2048;
INCLUDE vg5t_common.ld
INCLUDE vg5t_sections.ld
